## tests/integration/fixtures/meta-kernel-cve/conf/layer.conf
```bitbake
# SPDX-License-Identifier: MIT
BBPATH .= ":${LAYERDIR}"
BBFILES += "${LAYERDIR}/recipes-*/*/*.bbappend"
BBFILE_COLLECTIONS += "kernel-cve-tests"
BBFILE_PATTERN_kernel-cve-tests = "^${LAYERDIR}/"
LAYERDEPENDS_kernel-cve-tests = "core cyclonedx"
LAYERSERIES_COMPAT_kernel-cve-tests = "blacksail wrynose scarthgap"
```
