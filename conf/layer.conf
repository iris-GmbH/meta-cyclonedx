## conf/layer.conf
```bitbake
# SPDX-License-Identifier: MIT

# We have a conf and classes directory, append to BBPATH
BBPATH .= ":${LAYERDIR}"

BBFILE_COLLECTIONS += "cyclonedx"
BBFILE_PATTERN_cyclonedx = "^${LAYERDIR}/"

# This layer does not contain any .bb file, only a .bbclass.
BBFILE_PATTERN_IGNORE_EMPTY_cyclonedx = "1"

LAYERDEPENDS_cyclonedx = "core"
LAYERSERIES_COMPAT_cyclonedx = "kirkstone"

# backport cve-check-map from styhead 
# https://github.com/yoctoproject/poky/blob/styhead/meta/conf/cve-check-map.conf
include ${LAYERDIR}/conf/cve-check-map.conf
```
